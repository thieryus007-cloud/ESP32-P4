## Kconfig.projbuild
```kconfig
menu "HMI operation mode"

config HMI_DEFAULT_OPERATION_MODE
    int "Mode par défaut (0 = Connecté S3, 1 = Autonome TinyBMS)"
    range 0 1
    default 1
    help
        Définit le mode de fonctionnement utilisé au premier démarrage.
        0 : le firmware active la connectivité S3 (WiFi + WebSockets)
        1 : mode autonome uniquement TinyBMS (aucune télémétrie réseau attendue)

config HMI_WIFI_FAILOVER_ENABLED
    bool "Activer la bascule automatique en mode autonome si le WiFi échoue"
    default y
    help
        Lorsque activé, un nombre configurable d'échecs WiFi déclenchera
        automatiquement une bascule vers le mode autonome TinyBMS. La GUI est
        notifiée via un événement dédié.

config HMI_WIFI_FAILOVER_THRESHOLD
    int "Nombre d'échecs WiFi avant bascule"
    range 1 10
    default 3
    depends on HMI_WIFI_FAILOVER_ENABLED
    help
        Nombre de séquences de reconnexion WiFi échouées avant de publier un
        événement de bascule automatique vers le mode autonome.

endmenu

menu "Network telemetry publisher"

config NETWORK_TELEMETRY_PUBLISHER_ENABLED
    bool "Activer le publish MQTT/HTTP périodique"
    default y
    help
        Quand activé, un point de télémétrie TinyBMS est échantillonné puis
        envoyé vers HTTP/MQTT à intervalle régulier.

config NETWORK_TELEMETRY_PERIOD_MS
    int "Période d'envoi (ms)"
    range 1000 60000
    default 5000
    depends on NETWORK_TELEMETRY_PUBLISHER_ENABLED
    help
        Intervalle entre deux publications successives.

config NETWORK_TELEMETRY_HTTP_PATH
    string "Endpoint HTTP de publication"
    default "/api/telemetry/local"
    depends on NETWORK_TELEMETRY_PUBLISHER_ENABLED
    help
        Route HTTP relative utilisée pour pousser les points de télémétrie.

config NETWORK_TELEMETRY_MQTT_TOPIC
    string "Topic MQTT"
    default "tinybms/telemetry"
    depends on NETWORK_TELEMETRY_PUBLISHER_ENABLED
    help
        Topic MQTT sur lequel les télémétries sont publiées.

config NETWORK_TELEMETRY_BUFFER_DEPTH
    int "Taille du tampon offline"
    range 1 128
    default 32
    depends on NETWORK_TELEMETRY_PUBLISHER_ENABLED
    help
        Nombre maximum de points conservés en cas de perte réseau avant
        reconnexion.

config NETWORK_TELEMETRY_OFFLINE_BUFFER
    bool "Activer le mode offline buffer"
    default y
    depends on NETWORK_TELEMETRY_PUBLISHER_ENABLED
    help
        Lorsque activé, les points produits hors-ligne sont empilés puis
        rejoués à la reconnexion.

endmenu
```
